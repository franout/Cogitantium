/*
 * CAUTION: This file is automatically generated by Xilinx.
 * Version: XSCT 2019.2.1
 * Today is: Sat Feb 15 18:48:21 2020
 */


/ {
	amba_pl: amba_pl {
		#address-cells = <1>;
		#size-cells = <1>;
		compatible = "simple-bus";
		ranges ;
		apb_bridge_wrapper_0: apb_bridge_wrapper@40000000 {
			/* This is a place holder node for a custom IP, user may need to update the entries */
			clock-names = "s_axi_aclk";
			clocks = <&clkc 15>;
			compatible = "xlnx,apb-bridge-wrapper-1.0";
			reg = <0x40000000 0x10000>;
		};
	};
};
