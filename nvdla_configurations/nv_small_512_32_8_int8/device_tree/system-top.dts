/*
 * CAUTION: This file is automatically generated by Xilinx.
 * Version: XSCT 2019.2.1
 * Today is: Sat Feb 15 18:48:21 2020
 */


/dts-v1/;
#include "zynq-7000.dtsi"
#include "pl.dtsi"
#include "pcw.dtsi"
/ {
	chosen {
		bootargs = "earlycon";
		stdout-path = "serial0:115200n8";
	};
	aliases {
		serial0 = &uart1;
		spi0 = &qspi;
	};
	memory {
		device_type = "memory";
		reg = <0x0 0x10000000>;
	};
};
